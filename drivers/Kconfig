## drivers/dp_pio/Kconfig
```kconfig
config SWDP_PIO
	bool "PIO-accelerated SWD port driver"
	default y
	depends on PIO_RPI_PICO
	help
	  SWD port driver using the RP2 PIO, ported from the Raspberry Pi
	  debugprobe firmware. Implements the swdp_api.

	  Compiles whenever the misc PIO HAL (PIO_RPI_PICO) is available; a
	  device is registered only when a raspberrypi,swdp-pio devicetree node
	  is enabled (DT_INST_FOREACH_STATUS_OKAY).
```

## drivers/sbw_pio/Kconfig
```kconfig
config SBW_PIO
	bool "PIO Spy-Bi-Wire transport (MSP430)"
	depends on PIO_RPI_PICO
	depends on DT_HAS_DEBUGPROBE_SBW_PIO_ENABLED
	help
	  Clocks MSP430 Spy-Bi-Wire cycles with the RP2 PIO. Selected by
	  PROBE_MSP430_SBW; a device is registered for each enabled
	  debugprobe,sbw-pio devicetree node.
```
